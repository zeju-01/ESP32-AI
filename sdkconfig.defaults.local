## sdkconfig.defaults.local
```kconfig
# 使用bread-compact-wifi-s3cam开发板配置
CONFIG_BOARD_TYPE_BREAD_COMPACT_WIFI_CAM=y

# 取消其他BOARD_TYPE配置
CONFIG_BOARD_TYPE_BREAD_COMPACT_WIFI=n
CONFIG_BOARD_TYPE_BREAD_COMPACT_ML307=n
CONFIG_BOARD_TYPE_BREAD_COMPACT_NT26=n
CONFIG_BOARD_TYPE_BREAD_COMPACT_ESP32=n
CONFIG_BOARD_TYPE_BREAD_COMPACT_ESP32_LCD=n
CONFIG_BOARD_TYPE_DF_K10=n
CONFIG_BOARD_TYPE_DF_S3_AI_CAM=n
CONFIG_BOARD_TYPE_ESP_BOX_3=n
CONFIG_BOARD_TYPE_BREAD_COMPACT_WIFI_LCD=n
```
